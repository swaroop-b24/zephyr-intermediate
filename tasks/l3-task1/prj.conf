## CMakeLists.txt
```
cmake_minimum_required(VERSION 3.20.0)
find_package(Zephyr REQUIRED HINTS $ENV{ZEPHYR_BASE})
project(l3_task1)

target_sources(app PRIVATE src/main.c)
```

## prj.conf
```kconfig
CONFIG_LOG=y
CONFIG_THREAD_NAME=y
```

## src/main.c
```c
/*
 * Lecture 3 - Homework Solution (BONUS: debounce)
 *
 * GOAL: sensor_sim fires a burst of 5 events within 20ms. Using
 * k_work_reschedule() with a 30ms delay means every new submission
 * pushes the handler's execution further out - so only the LAST
 * event in the burst actually results in a handler run, 30ms after
 * the burst settles. The other 4 "reschedules" are absorbed.
 */

#include <zephyr/kernel.h>
#include <zephyr/logging/log.h>

LOG_MODULE_REGISTER(homework, LOG_LEVEL_DBG);

#define STACK_SIZE       1024
#define BURST_EVENTS     5
#define BURST_SPACING_MS 4
#define DEBOUNCE_MS      30

static int total_events;
static int total_handler_runs;

static void sensor_handler(struct k_work *work)
{
	ARG_UNUSED(work);
	total_handler_runs++;
	LOG_INF("[HANDLER] fired (debounced)  run=%d  tick=%u",
		total_handler_runs, k_uptime_get_32());
}

K_WORK_DELAYABLE_DEFINE(debounce_work, sensor_handler);

static void sensor_sim_fn(void *p1, void *p2, void *p3)
{
	ARG_UNUSED(p1); ARG_UNUSED(p2); ARG_UNUSED(p3);

	k_msleep(200);
	LOG_INF("[SENSOR] burst starting  tick=%u", k_uptime_get_32());

	for (int i = 0; i < BURST_EVENTS; i++) {
		total_events++;
		LOG_INF("[SENSOR] event %d  tick=%u  -> reschedule +%dms",
			i, k_uptime_get_32(), DEBOUNCE_MS);

		k_work_reschedule(&debounce_work, K_MSEC(DEBOUNCE_MS));

		if (i < BURST_EVENTS - 1) {
			k_msleep(BURST_SPACING_MS);
		}
	}

	LOG_INF("[SENSOR] burst complete, %d events fired within ~%dms",
		BURST_EVENTS, (BURST_EVENTS - 1) * BURST_SPACING_MS);
}

K_THREAD_DEFINE(sensor_thread, STACK_SIZE, sensor_sim_fn, NULL, NULL, NULL, 5, 0, 0);

int main(void)
{
	LOG_INF("=== L3 Homework BONUS: Debounce via k_work_reschedule ===");
	LOG_INF("Firing %d events within ~%dms, debounce window=%dms",
		BURST_EVENTS, (BURST_EVENTS - 1) * BURST_SPACING_MS, DEBOUNCE_MS);

	k_msleep(500);

	LOG_INF("\n");
	LOG_INF("[SUMMARY] events_fired=%d  handler_runs=%d  "
		"(burst of %d collapsed to %d execution)",
		total_events, total_handler_runs, total_events, total_handler_runs);

	return 0;
}
```

## src/main_task2_workqueue.c
```c
/*
 * Lecture 3 - Homework Solution (Task 2 + Task 3)
 *
 * GOAL: Event-driven workqueue architecture instead of polling.
 *
 * sensor_sim fires every 100ms and submits a k_work item directly -
 * no shared flag, no polling thread waking up every 10ms to check it.
 * The system workqueue's own worker thread runs sensor_handler()
 * only when there's actually work to do.
 */

#include <zephyr/kernel.h>
#include <zephyr/logging/log.h>

LOG_MODULE_REGISTER(homework, LOG_LEVEL_DBG);

#define STACK_SIZE    1024
#define SENSOR_MS     100    /* sensor fires every 100ms */
#define EVENT_COUNT   10     /* total sensor events to produce */

/* Statistics */
static int total_events;
static int total_processed;

/* ------------------------------------------------------------------ */
/*  Task 2: work handler - runs ONLY when submitted, no polling        */
/* ------------------------------------------------------------------ */

static void sensor_handler(struct k_work *work)
{
	ARG_UNUSED(work);

	total_processed++;

	/* Task 3: timestamp confirms this only runs on real events,
	 * at ~100ms intervals matching sensor_sim - not every 10ms. */
	LOG_INF("[HANDLER] processed event %d  tick=%u",
		total_processed, k_uptime_get_32());
}

K_WORK_DEFINE(sensor_work, sensor_handler);

/* ------------------------------------------------------------------ */
/*  sensor_sim - fires EVENT_COUNT events, 100ms apart                */
/* ------------------------------------------------------------------ */

static void sensor_sim_fn(void *p1, void *p2, void *p3)
{
	ARG_UNUSED(p1); ARG_UNUSED(p2); ARG_UNUSED(p3);

	for (int i = 0; i < EVENT_COUNT; i++) {
		k_msleep(SENSOR_MS);

		total_events++;
		LOG_INF("[SENSOR] event %d  tick=%u", i, k_uptime_get_32());

		int ret = k_work_submit(&sensor_work);

		if (ret < 0) {
			LOG_ERR("submit failed: %d", ret);
		}
	}

	LOG_INF("[SENSOR] all events produced");
}

K_THREAD_DEFINE(sensor_thread, STACK_SIZE, sensor_sim_fn, NULL, NULL, NULL, 5, 0, 0);

int main(void)
{
	LOG_INF("=== L3 Homework: Workqueue solution ===");
	LOG_INF("sensor fires every %dms, handler runs only on real events",
		SENSOR_MS);

	/* Wait long enough for all events to complete */
	k_msleep((EVENT_COUNT + 2) * SENSOR_MS + 500);

	LOG_INF("\n");
	LOG_INF("[SUMMARY] events=%d  processed=%d  (no wasted wakeups - "
		"handler only runs on real events)",
		total_events, total_processed);

	return 0;
}
```
